## sdkconfig.defaults
```kconfig
#
# Modbus configuration
#
CONFIG_MB_COMM_MODE_ASCII=n
CONFIG_MB_UART_BAUD_RATE=9600
CONFIG_FMB_TIMER_PORT_ENABLED=n
CONFIG_FMB_MASTER_DELAY_MS_CONVERT=200
CONFIG_FMB_MASTER_TIMEOUT_MS_RESPOND=2000
CONFIG_FMB_TIMER_USE_ISR_DISPATCH_METHOD=y

#
# Wireless + BLE config
#
CONFIG_BT_ENABLED=y
CONFIG_BTDM_CTRL_MODE_BLE_ONLY=y
CONFIG_BT_BLUEDROID_ENABLED=n
CONFIG_BT_NIMBLE_ENABLED=y
CONFIG_BT_CTRL_BLE_MAX_ACT=10
CONFIG_BT_NIMBLE_MAX_BLE_CONN=3
CONFIG_BT_NIMBLE_MAX_BLE_ADV_INSTANCES=1
CONFIG_BT_NIMBLE_GATT_MAX_SERVICES=8
CONFIG_BT_NIMBLE_GATT_MAX_CHARS=32
CONFIG_BT_NIMBLE_ATT_PREFERRED_MTU=256
CONFIG_BT_NIMBLE_SVC_GAP_DEVICE_NAME="THMB02S Config"
```
